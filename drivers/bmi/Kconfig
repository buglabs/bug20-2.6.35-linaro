## drivers/bmi/Kconfig
```kconfig
#
# BMI Infrastructure
#

menuconfig BMI
       tristate "BMI"
       depends on I2C && BUG_DOCK
       default n
       ---help---
         BMI bus infrastructure

if BMI

source drivers/bmi/slots/Kconfig
source drivers/bmi/pims/Kconfig

endif # BMI
```

## drivers/bmi/pims/Kconfig
```kconfig
#
# BMI PIMS
#

config BMI_PIMS
	tristate "BMI_PIMS"
	depends on BMI
	default n
	---help---
	  BMI plug-in module support

	  This driver must be built as a module.

menu "BMI PIMS"

config BUG_FACTORY_TEST
	tristate "BUG_FACTORY_TEST"
	depends on BMI_PIMS
	default n
	---help---
	  BMI FACTORY Test plug-in module

	  This driver can also be built as a module.

config BMI_GPS
	tristate "BMI_GPS"
	depends on BMI_PIMS
	default n
	---help---
	  BMI GPS plug-in module

	  This driver can also be built as a module.

source "drivers/bmi/pims/mdacc/Kconfig"

config BMI_LCD
	tristate "BMI LCD Module support"
	depends on BMI_PIMS
	default n
	---help---
	  This is the BMI driver for the LCD Plug-In Module.

config BMI_VIDEO
	tristate "BMI Video Module support"
	depends on BMI_PIMS && TFP410 && THS8200
        depends on GPIO_PCA953X && (FIRMWARE_EDID = y)
	default n
	---help---
	  This is the BMI driver for the Video Plug-In Module (DVI/VGA).

config BMI_AUDIO
	tristate "BMI Audio Module support"
	depends on BMI_PIMS
	default n
	---help---
	  This is the BMI bus driver for the Audio Plug-In Module.

	  Select M to make a kernel-loadable module.

config BMI_AUDIO_CODECS
        bool
        select SND_OMAP_SOC_MCBSP
        select SND_SOC_TLV320AIC3X
	default y if BMI_AUDIO

source "drivers/bmi/pims/camera/Kconfig"

config BMI_VH
	tristate "BMI von Hippel Module support"
	depends on BMI_PIMS
	default n
	---help---
	  BMI von Hippel plug-in module

	  This driver can also be built as a module.

config BMI_SENSOR
        tristate "BMI Sensor Module support"
        depends on BMI_PIMS
        default n
        ---help---
          BMI Sensor plug-in module

          This driver can also be built as a module.

config BMI_ZB
	tristate "BMI ZigBee Module support"
	depends on BMI_PIMS
	default n
	---help---
	  BMI ZigBee plug-in module

	  This driver can also be built as a module.

config BMI_GSM
	tristate "BMI GSM/UMTS Module support"
	depends on BMI_PIMS
	default n
	---help---
	  BMI von Hippel plug-in module

	  This driver can also be built as a module.

config BMI_ACCNT
        tristate "Accenture BMI Accelerometer Module support"
        depends on BMI_PIMS
        default n
        ---help---
          BMI Sensor plug-in module

          This driver can also be built as a module.


config BMI_BUGDUINO
        tristate "Bug Arduino BMI Module support"
        depends on BMI_PIMS
        default n
        ---help---
          BMI Bug Arduino plug-in module

          This driver can also be built as a module.

config BMI_RF4CE
	tristate "BMI GP RF4CE Module support"
	depends on BMI_PIMS
	default n
	---help---
	  BMI GreenPeak RF4CE plug-in module

	  This driver can also be built as a module.

config BMI_DECT
	tristate "BMI DECT Module support"
	depends on BMI_PIMS
	default n
	---help---
	  BMI DSPG DCX79 USB DECT Dongle module

	  This driver can also be built as a module.

config BMI_DLNA_MEDIA
	tristate "BMI DLNA Media Module support"
	depends on BMI_PIMS
	default n
	---help---
	  BMI VIXS XC5195 Network Processor module that support DLNA
	  media server, MoCA, and IEEE1394/Firewire

	  This driver can also be built as a module.


endmenu
```

## drivers/bmi/pims/camera/Kconfig
```kconfig
config BMI_CAMERA
	tristate "BMI Camera"
	depends on BMI_PIMS
	select VIDEO_OMAP3
	select OMAP_IOMMU
	default n
	---help---
	  This is the BMI Camera driver.

choice
        prompt "Select Camera"
        depends on (BMI_CAMERA)

#config BMI_CAMERA_VS6624
#        tristate "ST VS6624 camera support"
#        ---help---
#          If you plan to use the ST VS6624 Camera with your BUG system, say Y here.
#
#config BMI_CAMERA_OV2640
#        tristate "Omnivision OV2640 camera support"
#        ---help---
#          If you plan to use the Omnivision OV2640 Camera with your BUG system, say Y here.
#
config BMI_CAMERA_LI3M02CM
        tristate "Leopard Imaging 3M02CM / Aptina MT9T111 camera support"
        ---help---
          If you plan to use the "Leopard Imaging 3M02CM / Aptina MT9T11 camera with your BUG system, say Y here.

endchoice
```

## drivers/bmi/pims/comcast/Kconfig
```kconfig
config BMI_COMCAST
	tristate "BMI Comcast Modules"
	depends on BMI_PIMS && MTD_M25P80
	default y
	---help---
	  This is the BMI Comcast drivers.
```

## drivers/bmi/pims/mdacc/Kconfig
```kconfig
config BMI_MDACC
	tristate "BMI Motion Detector/Accelerometer"
	depends on BMI_PIMS
	default n
	---help---
	  This is the BMI Motion Detector/Acceleromter driver.
```

## drivers/bmi/slots/Kconfig
```kconfig
#
# BMI Slot Drivers
#

menu "BMI Hardware Slot support"

config BUG_SLOT
	tristate "Buglabs BUGBase BMI Slots"
	default 'n'
	depends on BMI && MACH_BUG
	help
	  If you say yes to this option, support will be included for the Buglabs BUGBase BMI Slot/Module Ports.

config BEAGLE_SLOT
       	tristate "TI BeagBoard BMI Slots"
	default 'n'
	depends on BMI
	help
	  If you say yes to this option, support will be included for the BeagleBoard Slot.

config OMAP_BUG_SLOT
       	tristate "Buglabs 2.0 BUGbase BMI Slots"
	default 'n'
	depends on BMI
	help
	  If you say yes to this option, support will be included for the BeagleBoard Slot.

endmenu
```
